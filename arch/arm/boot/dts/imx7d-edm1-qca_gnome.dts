/*
 * Copyright 2018 TechNexion Ltd.
 *
 * Author: Tapani Utriainen <tapani@technexion.com>
 *         Richard Hu <richard.hu@technexion.com>
 *         Ray Chang <ray.chang@technexion.com>
 *
 * This program is free software; you can redistribute it and/or modify
 * it under the terms of the GNU General Public License version 2 as
 * published by the Free Software Foundation.
 *
 */
/dts-v1/;

#include "imx7d.dtsi"
#include "imx7d-edm1-qca.dtsi"
#include "baseboard_edm1_gnome.dtsi"

/ {
	model = "Technexion EDM1-IMX7 Dual/Solo with Gnome baseboard";
	compatible = "fsl,imx7d-edm1", "fsl,imx7d";
};

